## examples/ali-smartliving/sdkconfig_defaults/sdkconfig.defaults.esp32
```kconfig
CONFIG_ESPTOOLPY_BAUD_921600B=y
CONFIG_ESPTOOLPY_FLASHSIZE_4MB=y
CONFIG_TIMER_TASK_STACK_DEPTH=3072
CONFIG_PARTITION_TABLE_CUSTOM=y
CONFIG_PARTITION_TABLE_CUSTOM_FILENAME="partition_table/partitions_esp32.csv"

#
# lightbulb
#
CONFIG_LIGHTBULB_R=25
CONFIG_LIGHTBULB_G=26
CONFIG_LIGHTBULB_B=27
```

## examples/dual-clouds/default_configs/esp32/sdkconfig.defaults
```kconfig
#
# Serial flasher config
#
CONFIG_ESPTOOLPY_BAUD_921600B=y
CONFIG_ESPTOOLPY_FLASHMODE_QIO=y
CONFIG_ESPTOOLPY_FLASHSIZE_4MB=y

#
# Partition Table
#
CONFIG_PARTITION_TABLE_CUSTOM=y
CONFIG_PARTITION_TABLE_CUSTOM_FILENAME="default_configs/esp32/partitions_esp32.csv"
CONFIG_PARTITION_TABLE_FILENAME="default_configs/esp32/partitions_esp32.csv"

#
# Bluetooth
#
CONFIG_BT_ENABLED=y

#
# Bluetooth controller
#
CONFIG_BTDM_CTRL_MODE_BLE_ONLY=y

#
# Wi-Fi
#
CONFIG_ESP32_WIFI_SW_COEXIST_ENABLE=y

CONFIG_JOYLINK_BLE_ENABLE=n

#
# lightbulb
#
CONFIG_LIGHTBULB_R=25
CONFIG_LIGHTBULB_G=26
CONFIG_LIGHTBULB_B=27
```

## examples/dual-clouds/default_configs/esp8266/sdkconfig.defaults
```kconfig
#
# Serial flasher config
#
CONFIG_ESPTOOLPY_BAUD_921600B=y
CONFIG_ESPTOOLPY_FLASHMODE_QIO=y
CONFIG_ESPTOOLPY_FLASHSIZE_2MB=y

#
# Partition Table
#
CONFIG_PARTITION_TABLE_CUSTOM=y
CONFIG_PARTITION_TABLE_CUSTOM_FILENAME="default_configs/esp8266/partitions_esp8266.csv"
CONFIG_PARTITION_TABLE_FILENAME="default_configs/esp8266/partitions_esp8266.csv"


CONFIG_ENABLE_PTHREAD=y

CONFIG_MBEDTLS_SSL_IN_CONTENT_LEN=4096
CONFIG_MBEDTLS_KEY_EXCHANGE_DHE_RSA=n
CONFIG_MBEDTLS_KEY_EXCHANGE_ELLIPTIC_CURVE=n
CONFIG_MBEDTLS_KEY_EXCHANGE_ECDHE_RSA=n
CONFIG_MBEDTLS_KEY_EXCHANGE_ECDHE_ECDSA=n
CONFIG_MBEDTLS_KEY_EXCHANGE_ECDH_ECDSA=n
CONFIG_MBEDTLS_KEY_EXCHANGE_ECDH_RSA=n

CONFIG_NEWLIB_NANO_FORMAT=n

#
# ESP8266-specific
#
CONFIG_WIFI_PPT_TASKSTACK_SIZE=3500

#
# Wi-Fi
#
CONFIG_WIFI_TX_RATE_SEQUENCE_FROM_HIGH=n
CONFIG_ESP8266_WIFI_RX_BUFFER_NUM=14
CONFIG_ESP8266_WIFI_RX_PKT_NUM=4
CONFIG_ESP8266_WIFI_TX_PKT_NUM=4

#
# mbedTLS
#
CONFIG_MBEDTLS_DYNAMIC_BUFFER=y
CONFIG_MBEDTLS_DYNAMIC_FREE_PEER_CERT=y
CONFIG_MBEDTLS_DYNAMIC_FREE_CONFIG_DATA=y

#
# lightbulb
#
CONFIG_LIGHTBULB_R=4
CONFIG_LIGHTBULB_G=5
CONFIG_LIGHTBULB_B=15
```
